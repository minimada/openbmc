## meta-evb/meta-evb-nuvoton/meta-buv-runbmc/conf/distro/buv-entity.conf
```bitbake
require conf/distro/openbmc-phosphor.conf

VIRTUAL-RUNTIME_obmc-inventory-manager = "entity-manager"
VIRTUAL-RUNTIME_obmc-sensors-hwmon = "dbus-sensors"

PREFERRED_PROVIDER_virtual/obmc-system-mgmt = "packagegroup-buv-runbmc-apps"
PREFERRED_PROVIDER_virtual/obmc-inventory-data = "entity-manager"

DISTRO = "buv-entity"
```

## meta-evb/meta-evb-nuvoton/meta-buv-runbmc/conf/machine/buv-entity.conf
```bitbake
KMACHINE = "nuvoton"
KERNEL_DEVICETREE = "${KMACHINE}-npcm750-buv-runbmc.dtb"

require conf/machine/include/npcm7xx.inc
require conf/machine/include/obmc-bsp-common.inc

FLASH_SIZE = "65536"
FLASH_UBOOT_OFFSET = "0"
FLASH_KERNEL_OFFSET = "2048"
FLASH_ROFS_OFFSET = "8192"
FLASH_RWFS_OFFSET = "62464"

UBOOT_MACHINE = "PolegRunBMC_defconfig"
UBOOT_DEVICETREE = "nuvoton-npcm750-buv"
IGPS_MACHINE = "RunBMC"

IMAGE_FSTYPES += " cpio.${INITRAMFS_CTYPE}.u-boot"

OBMC_MACHINE_FEATURES += "\
        obmc-phosphor-fan-mgmt \
        obmc-phosphor-chassis-mgmt \
        obmc-phosphor-flash-mgmt \
        obmc-host-ipmi \
        obmc-host-state-mgmt \
        obmc-chassis-state-mgmt \
        obmc-bmc-state-mgmt \
        "

VIRTUAL-RUNTIME_obmc-inventory-manager = "entity-manager"
VIRTUAL-RUNTIME_obmc-sensors-hwmon = "dbus-sensors"

PREFERRED_PROVIDER_virtual/obmc-system-mgmt = "packagegroup-buv-runbmc-apps"
PREFERRED_PROVIDER_virtual/obmc-inventory-data = "entity-manager"
```
