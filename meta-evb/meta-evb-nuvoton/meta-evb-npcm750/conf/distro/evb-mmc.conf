## meta-evb/meta-evb-nuvoton/meta-evb-npcm750/conf/distro/evb-mmc.conf
```bitbake
require conf/distro/openbmc-phosphor.conf

DISTRO = "evb-mmc"
DISTRO_NAME = "Nuvoton OpenBMC (EVB eMMC)"
DISTRO_FEATURES:append = " evb_mmc"
```

## meta-evb/meta-evb-nuvoton/meta-evb-npcm750/conf/machine/evb-npcm750-emmc.conf
```bitbake
require conf/machine/include/npcm7xx.inc
require conf/machine/include/obmc-bsp-common.inc
require conf/machine/include/runbmc-emmc.conf

KMACHINE = "nuvoton"
KERNEL_DEVICETREE = "${KMACHINE}-npcm750-evb.dtb"
UBOOT_MACHINE = "PolegSVB_config"
UBOOT_DEVICETREE = "nuvoton-npcm750-evb"
IGPS_MACHINE = "EB"

FLASH_SIZE = "32768"

OBMC_MACHINE_FEATURES += "\
        obmc-phosphor-fan-mgmt \
        obmc-phosphor-chassis-mgmt \
        obmc-phosphor-flash-mgmt \
        obmc-host-ipmi \
        obmc-host-state-mgmt \
        obmc-chassis-state-mgmt \
        obmc-bmc-state-mgmt \
        "

PREFERRED_PROVIDER_virtual/obmc-chassis-mgmt = "packagegroup-evb-npcm750-apps"
PREFERRED_PROVIDER_virtual/obmc-fan-mgmt = "packagegroup-evb-npcm750-apps"
PREFERRED_PROVIDER_virtual/obmc-flash-mgmt = "packagegroup-evb-npcm750-apps"
PREFERRED_PROVIDER_virtual/obmc-system-mgmt = "packagegroup-evb-npcm750-apps"
PREFERRED_PROVIDER_virtual/phosphor-led-manager-config-native = "npcm750-led-manager-config-native"
PREFERRED_PROVIDER_virtual/obmc-host-ipmi-hw = "phosphor-ipmi-kcs"
PREFERRED_PROVIDER_virtual/phosphor-ipmi-inventory-sel = "npcm750-ipmi-inventory-sel-native"
PREFERRED_PROVIDER_virtual/phosphor-ipmi-sensor-inventory = "npcm750-ipmi-sensor-inventory-native"
PREFERRED_PROVIDER_virtual/phosphor-ipmi-fru-inventory = "npcm750-ipmi-inventory-map-native"

PACKAGE_INSTALL_append = " python3"
```
